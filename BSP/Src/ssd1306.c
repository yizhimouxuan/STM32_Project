#include "ssd1306.h"

#include <string.h>
#include <stdio.h>

#define SSD1306_I2C_ADDR   (0x3C << 1)
#define SSD1306_BUFFER_SIZE (SSD1306_WIDTH * SSD1306_HEIGHT / 8)

typedef struct {
    uint16_t CurrentX;
    uint16_t CurrentY;
    uint8_t Initialized;
    I2C_HandleTypeDef *i2c;
} SSD1306_t;

static SSD1306_t ssd1306 = {0};
static uint8_t SSD1306_Buffer[SSD1306_BUFFER_SIZE];

static const uint8_t Font5x7[][5] = {
    {0x00,0x00,0x00,0x00,0x00}, // 20
    {0x00,0x00,0x5f,0x00,0x00}, // 21 !
    {0x00,0x07,0x00,0x07,0x00}, // 22 "
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    {0x08,0x04,0x08,0x10,0x08}, // 7e ~
};

static HAL_StatusTypeDef ssd1306_write_cmd(uint8_t cmd) {
    uint8_t data[2] = {0x00, cmd};
    return HAL_I2C_Master_Transmit(ssd1306.i2c, SSD1306_I2C_ADDR, data, 2, HAL_MAX_DELAY);
}

static HAL_StatusTypeDef ssd1306_write_data(uint8_t *data, uint16_t size) {
    return HAL_I2C_Master_Transmit(ssd1306.i2c, SSD1306_I2C_ADDR, data, size, HAL_MAX_DELAY);
}

static void ssd1306_draw_pixel(uint8_t x, uint8_t y, ssd1306_color_t color) {
    if (x >= SSD1306_WIDTH || y >= SSD1306_HEIGHT) {
        return;
    }
    uint32_t byte_index = x + (y / 8) * SSD1306_WIDTH;
    if (color == SSD1306_COLOR_WHITE) {
        SSD1306_Buffer[byte_index] |= 1 << (y % 8);
    } else {
        SSD1306_Buffer[byte_index] &= ~(1 << (y % 8));
    }
}

bool ssd1306_init(I2C_HandleTypeDef *i2c) {
    ssd1306.i2c = i2c;

    if (ssd1306_write_cmd(0xAE) != HAL_OK) return false; // display off
    ssd1306_write_cmd(0xD5); ssd1306_write_cmd(0x80);     // clk div
    ssd1306_write_cmd(0xA8); ssd1306_write_cmd(0x3F);     // multiplex
    ssd1306_write_cmd(0xD3); ssd1306_write_cmd(0x00);     // display offset
    ssd1306_write_cmd(0x40);                              // start line
    ssd1306_write_cmd(0x8D); ssd1306_write_cmd(0x14);     // charge pump
    ssd1306_write_cmd(0x20); ssd1306_write_cmd(0x00);     // horizontal addressing mode
    ssd1306_write_cmd(0xA1);                              // segment remap
    ssd1306_write_cmd(0xC8);                              // COM scan direction
    ssd1306_write_cmd(0xDA); ssd1306_write_cmd(0x12);     // COM pins
    ssd1306_write_cmd(0x81); ssd1306_write_cmd(0xCF);     // contrast
    ssd1306_write_cmd(0xD9); ssd1306_write_cmd(0xF1);     // pre-charge
    ssd1306_write_cmd(0xDB); ssd1306_write_cmd(0x40);     // VCOM detect
    ssd1306_write_cmd(0xA4);                              // resume to RAM content
    ssd1306_write_cmd(0xA6);                              // normal display
    ssd1306_write_cmd(0x2E);                              // stop scroll
    ssd1306_write_cmd(0xAF);                              // display on

    ssd1306_fill(SSD1306_COLOR_BLACK);
    ssd1306_update();

    ssd1306.Initialized = 1;
    return true;
}

void ssd1306_fill(ssd1306_color_t color) {
    memset(SSD1306_Buffer, (color == SSD1306_COLOR_WHITE) ? 0xFF : 0x00, sizeof(SSD1306_Buffer));
}

void ssd1306_update(void) {
    for (uint8_t page = 0; page < (SSD1306_HEIGHT / 8); page++) {
        ssd1306_write_cmd(0xB0 + page); // set page
        ssd1306_write_cmd(0x00);        // lower column start
        ssd1306_write_cmd(0x10);        // higher column start

        uint8_t line[SSD1306_WIDTH + 1];
        line[0] = 0x40; // data control byte
        memcpy(&line[1], &SSD1306_Buffer[SSD1306_WIDTH * page], SSD1306_WIDTH);
        ssd1306_write_data(line, sizeof(line));
    }
}

void ssd1306_set_cursor(uint8_t x, uint8_t y) {
    ssd1306.CurrentX = x;
    ssd1306.CurrentY = y;
}

static bool ssd1306_write_char(char ch, ssd1306_color_t color) {
    uint8_t c = (uint8_t)ch;
    if (c < 0x20 || c > 0x7E) {
        c = '?';
    }

    if ((ssd1306.CurrentX + 6) >= SSD1306_WIDTH || (ssd1306.CurrentY + 8) >= SSD1306_HEIGHT) {
        return false;
    }

    const uint8_t *bitmap = Font5x7[c - 0x20];
    for (uint8_t col = 0; col < 5; col++) {
        uint8_t line = bitmap[col];
        for (uint8_t row = 0; row < 7; row++) {
            ssd1306_draw_pixel(ssd1306.CurrentX + col, ssd1306.CurrentY + row, (line & (1 << row)) ? color : SSD1306_COLOR_BLACK);
        }
    }

    // one column of spacing
    for (uint8_t row = 0; row < 7; row++) {
        ssd1306_draw_pixel(ssd1306.CurrentX + 5, ssd1306.CurrentY + row, SSD1306_COLOR_BLACK);
    }

    ssd1306.CurrentX += 6;
    return true;
}

bool ssd1306_write_string(const char *str, ssd1306_color_t color) {
    while (*str) {
        if (!ssd1306_write_char(*str, color)) {
            return false;
        }
        str++;
    }
    return true;
}

void ssd1306_display_metrics(float distance_m,
                             float right_dist_m,
                             float right_front_dist_m,
                             float left_dist_m,
                             float roll_deg,
                             float pitch_deg,
                             float yaw_deg) {
    if (!ssd1306.Initialized) {
        return;
    }

    char line[24];

    ssd1306_fill(SSD1306_COLOR_BLACK);

    ssd1306_set_cursor(0, 0);
    snprintf(line, sizeof(line), "F:%6.1fcm", distance_m * 100.0f);
    ssd1306_write_string(line, SSD1306_COLOR_WHITE);

    ssd1306_set_cursor(0, 10);
    snprintf(line, sizeof(line), "R:%6.1fcm", right_dist_m * 100.0f);
    ssd1306_write_string(line, SSD1306_COLOR_WHITE);

    ssd1306_set_cursor(0, 20);
    snprintf(line, sizeof(line), "RF:%5.1fcm", right_front_dist_m * 100.0f);
    ssd1306_write_string(line, SSD1306_COLOR_WHITE);

    ssd1306_set_cursor(0, 30);
    snprintf(line, sizeof(line), "L:%6.1fcm", left_dist_m * 100.0f);
    ssd1306_write_string(line, SSD1306_COLOR_WHITE);

    ssd1306_set_cursor(0, 40);
    snprintf(line, sizeof(line), "Roll:%6.2f", roll_deg);
    ssd1306_write_string(line, SSD1306_COLOR_WHITE);

    ssd1306_set_cursor(0, 50);
    snprintf(line, sizeof(line), "Y:%6.2f P:%5.2f", yaw_deg, pitch_deg);
    ssd1306_write_string(line, SSD1306_COLOR_WHITE);

    ssd1306_update();
}
